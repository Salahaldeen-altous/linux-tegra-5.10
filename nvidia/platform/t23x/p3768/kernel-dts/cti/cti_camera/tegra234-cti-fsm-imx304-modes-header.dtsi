#define SENSOR_MODE0				mclk_khz = "37125"; \
									phy_mode = "DPHY"; \
									discontinuous_clk = "no"; \
									dpcm_enable = "false"; \
									cil_settletime = "0"; \
									active_w = "4112"; \
									active_h = "3008"; \
									dynamic_pixel_bit_depth = "12"; \
									csi_pixel_bit_depth = "12"; \
									mode_type = "bayer"; \
									pixel_phase = "rggb"; \
									readout_orientation = "0"; \
									line_length = "4112"; \
									inherent_gain = "1"; \
									pix_clk_hz = "475200000"; \
									gain_factor = "10"; \
									min_gain_val = "0"; \
									max_gain_val = "480"; \
									step_gain_val = "1"; \
									default_gain = "0"; \
									min_hdr_ratio = "1"; \
									max_hdr_ratio = "64"; \
									framerate_factor = "1000000"; \
									min_framerate = "1500000"; \
									max_framerate = "24000000"; \
									step_framerate = "1"; \
									default_framerate= "24000000"; \
									exposure_factor = "1000000"; \
									min_exp_time = "28"; \
									max_exp_time = "660000"; \
									step_exp_time = "1"; \
									default_exp_time = "27879"; \
									embedded_metadata_height = "0";

#define SENSOR_MODE1				mclk_khz = "37125"; \
									phy_mode = "DPHY"; \
									discontinuous_clk = "no"; \
									dpcm_enable = "false"; \
									cil_settletime = "0"; \
									active_w = "4096"; \
									active_h = "2160"; \
									dynamic_pixel_bit_depth = "12"; \
									csi_pixel_bit_depth = "12"; \
									mode_type = "bayer"; \
									pixel_phase = "rggb"; \
									readout_orientation = "0"; \
									line_length = "4096"; \
									inherent_gain = "1"; \
									pix_clk_hz = "475200000"; \
									gain_factor = "10"; \
									min_gain_val = "0"; \
									max_gain_val = "480"; \
									step_gain_val = "1"; \
									default_gain = "0"; \
									min_hdr_ratio = "1"; \
									max_hdr_ratio = "64"; \
									framerate_factor = "1000000"; \
									min_framerate = "1500000"; \
									max_framerate = "31000000"; \
									step_framerate = "1"; \
									default_framerate= "30000000"; \
									exposure_factor = "1000000"; \
									min_exp_time = "28"; \
									max_exp_time = "660000"; \
									step_exp_time = "1"; \
									default_exp_time = "20906"; \
									embedded_metadata_height = "0";
					
#define SENSOR_MODE2				mclk_khz = "37125"; \
									phy_mode = "DPHY"; \
									discontinuous_clk = "no"; \
									dpcm_enable = "false"; \
									cil_settletime = "0"; \
									active_w = "3840"; \
									active_h = "2160"; \
									dynamic_pixel_bit_depth = "12"; \
									csi_pixel_bit_depth = "12"; \
									mode_type = "bayer"; \
									pixel_phase = "rggb"; \
									readout_orientation = "0"; \
									line_length = "3840"; \
									inherent_gain = "1"; \
									pix_clk_hz = "475200000"; \
									gain_factor = "10"; \
									min_gain_val = "0"; \
									max_gain_val = "480"; \
									step_gain_val = "1"; \
									default_gain = "0"; \
									min_hdr_ratio = "1"; \
									max_hdr_ratio = "64"; \
									framerate_factor = "1000000"; \
									min_framerate = "1500000"; \
									max_framerate = "31000000"; \
									step_framerate = "1"; \
									default_framerate= "30000000"; \
									exposure_factor = "1000000"; \
									min_exp_time = "28"; \
									max_exp_time = "660000"; \
									step_exp_time = "1"; \
									default_exp_time = "10000"; \
									embedded_metadata_height = "0";
										
								
#define CAM_DATA				physical_w = "15.00"; \
								physical_h = "12.50"; \
								post_crop_frame_drop = "0"; \
								use_decibel_gain = "true"; \
								delayed_gain = "false"; \
								use_sensor_mode_id = "false"; 
								
/{
	nvidia,dtsfilename = "../framos/FRAMOS_IMX304-Driver-Source_Jetson-Xavier/patch/imx304_galen_dtree.patch";
	nvidia,dtbbuildtime = __DATE__, __TIME__;
};
