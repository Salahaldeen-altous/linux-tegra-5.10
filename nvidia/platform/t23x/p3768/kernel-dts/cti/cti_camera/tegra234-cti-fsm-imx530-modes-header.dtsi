#define SENSOR_MODE0				mclk_khz = "37125";  \
		            phy_mode = "DPHY";  \
		            discontinuous_clk = "no";  \
		            dpcm_enable = "false";  \
		            cil_settletime = "0";  \
		            active_w = "5328";  \
		            active_h = "4608";  \
		            dynamic_pixel_bit_depth = "12";  \
		            csi_pixel_bit_depth = "12";  \
		            mode_type = "bayer";  \
		            pixel_phase = "rggb";  \
		            readout_orientation = "0";  \
		            line_length = "8000";  \
		            inherent_gain = "1";  \
		            pix_clk_hz = "475200000";  \
		            gain_factor = "10";  \
		            min_gain_val = "0";  \
		            max_gain_val = "480";  \
		            step_gain_val = "1"; \
		            default_gain = "0";  \
		            min_hdr_ratio = "1";  \
		            max_hdr_ratio = "64";  \
		            framerate_factor = "1000000";  \
		            min_framerate = "1500000";  \
		            max_framerate = "15000000";  \
		            step_framerate = "1";  \
		            default_framerate= "15000000";  \
		            exposure_factor = "1000000";  \
		            min_exp_time = "14";  \
		            max_exp_time = "660000";  \
		            step_exp_time = "1";  \
		            default_exp_time = "27879";  \
		            embedded_metadata_height = "0";


#define SENSOR_MODE1				mclk_khz = "37125";  \
		            phy_mode = "DPHY";  \
		            discontinuous_clk = "no";  \
		            dpcm_enable = "false";  \
		            cil_settletime = "0";  \
		            active_w = "3840";  \
		            active_h = "2160";  \
		            dynamic_pixel_bit_depth = "12";  \
		            csi_pixel_bit_depth = "12";  \
		            mode_type = "bayer";  \
		            pixel_phase = "rggb";  \
		            readout_orientation = "0";  \
		            line_length = "9000";  \
		            inherent_gain = "1";  \
		            pix_clk_hz = "475200000";  \
		            gain_factor = "10";  \
		            min_gain_val = "0";  \
		            max_gain_val = "480";  \
		            step_gain_val = "1";  \
		            default_gain = "0";  \
		            min_hdr_ratio = "1";  \
		            max_hdr_ratio = "64";  \
		            framerate_factor = "1000000";  \
		            min_framerate = "1500000";  \
		            max_framerate = "30000000";  \
		            step_framerate = "1";  \
		            default_framerate= "30000000";  \
		            exposure_factor = "1000000";  \
		            min_exp_time = "14";  \
		            max_exp_time = "660000";  \
		            step_exp_time = "1";  \
		            default_exp_time = "27879";  \
		            embedded_metadata_height = "0";


#define SENSOR_MODE2				mclk_khz = "37125";  \
		            phy_mode = "DPHY";  \
		            discontinuous_clk = "no"; \
		            dpcm_enable = "false";  \
		            cil_settletime = "0";  \
		            active_w = "4512";  \
		            active_h = "4512";  \
		            dynamic_pixel_bit_depth = "12";  \
		            csi_pixel_bit_depth = "12";  \
		            mode_type = "bayer";  \
		            pixel_phase = "rggb";  \
		            readout_orientation = "0";  \
		            line_length = "9000";  \
		            inherent_gain = "1";  \
		            pix_clk_hz = "475200000";  \
		            gain_factor = "10";  \
		            min_gain_val = "0";  \
		            max_gain_val = "480";  \
		            step_gain_val = "1";  \
		            default_gain = "0";  \
		            min_hdr_ratio = "1";  \
		            max_hdr_ratio = "64";  \
		            framerate_factor = "1000000";  \
		            min_framerate = "1500000";  \
		            max_framerate = "15000000";  \
		            step_framerate = "1";  \
		            default_framerate= "15000000";  \
		            exposure_factor = "1000000";  \
		            min_exp_time = "14";  \
		            max_exp_time = "660000";  \
		            step_exp_time = "1";  \
		            default_exp_time = "27879";  \
		            embedded_metadata_height = "0";


#define SENSOR_MODE3				mclk_khz = "37125";  \
		            phy_mode = "DPHY";  \
		            discontinuous_clk = "no";  \
		            dpcm_enable = "false";  \
		            cil_settletime = "0";  \
		            active_w = "5328";  \
		            active_h = "3040";  \
		            dynamic_pixel_bit_depth = "12";  \
		            csi_pixel_bit_depth = "12";  \
		            mode_type = "bayer";  \
		            pixel_phase = "rggb";  \
		            readout_orientation = "0";  \
		            line_length = "9000";  \
		            inherent_gain = "1";  \
		            pix_clk_hz = "475200000";  \
		            gain_factor = "10";  \
		            min_gain_val = "0";  \
		            max_gain_val = "480";  \
		            step_gain_val = "1";  \
		            default_gain = "0";  \
		            min_hdr_ratio = "1";  \
		            max_hdr_ratio = "64";  \
		            framerate_factor = "1000000";  \
		            min_framerate = "1500000";  \
		            max_framerate = "22000000";  \
		            step_framerate = "1";  \
		            default_framerate= "22000000";  \
		            exposure_factor = "1000000";  \
		            min_exp_time = "14";  \
		            max_exp_time = "660000";  \
		            step_exp_time = "1";  \
		            default_exp_time = "27879";  \
		            embedded_metadata_height = "0";


#define SENSOR_MODE4				mclk_khz = "37125";  \
		            phy_mode = "DPHY";  \
		            discontinuous_clk = "no";  \
		            dpcm_enable = "false";  \
		            cil_settletime = "0";  \
		            active_w = "4064";  \
		            active_h = "3008";  \
		            dynamic_pixel_bit_depth = "12";  \
		            csi_pixel_bit_depth = "12";  \
		            mode_type = "bayer";  \
		            pixel_phase = "rggb";  \
		            readout_orientation = "0";  \
		            line_length = "9000";  \
		            inherent_gain = "1";  \
		            pix_clk_hz = "475200000";  \
		            gain_factor = "10";  \
		            min_gain_val = "0";  \
		            max_gain_val = "480";  \
		            step_gain_val = "1";  \
		            default_gain = "0";  \
		            min_hdr_ratio = "1";  \
		            max_hdr_ratio = "64";  \
		            framerate_factor = "1000000";  \
		            min_framerate = "1500000";  \
		            max_framerate = "23000000";  \
		            step_framerate = "1";  \
		            default_framerate= "23000000";  \
		            exposure_factor = "1000000";  \
		            min_exp_time = "14";  \
		            max_exp_time = "660000";  \
		            step_exp_time = "1";  \
		            default_exp_time = "27879";  \
		            embedded_metadata_height = "0";


#define SENSOR_MODE5				mclk_khz = "37125";  \
		            phy_mode = "DPHY";  \
		            discontinuous_clk = "no";  \
		            dpcm_enable = "false";  \
		            cil_settletime = "0";  \
		            active_w = "2656";  \
		            active_h = "2304";  \
		            dynamic_pixel_bit_depth = "12";  \
		            csi_pixel_bit_depth = "12";  \
		            mode_type = "bayer";  \
		            pixel_phase = "rggb";  \
		            readout_orientation = "0";  \
		            line_length = "5400";  \
		            inherent_gain = "1";  \
		            pix_clk_hz = "475200000";  \
		            gain_factor = "10";  \
		            min_gain_val = "0";  \
		            max_gain_val = "480";  \
		            step_gain_val = "1";  \
		            default_gain = "0";  \
		            min_hdr_ratio = "1";  \
		            max_hdr_ratio = "64";  \
		            framerate_factor = "1000000";  \
		            min_framerate = "1500000";  \
		            max_framerate = "54000000";  \
		            step_framerate = "1";  \
		            default_framerate= "30000000";  \
		            exposure_factor = "1000000";  \
		            min_exp_time = "14";  \
		            max_exp_time = "660000";  \
		            step_exp_time = "1";  \
		            default_exp_time = "27879";  \
		            embedded_metadata_height = "0";


#define SENSOR_MODE6				mclk_khz = "37125";  \
		            phy_mode = "DPHY";  \
		            discontinuous_clk = "no";  \
		            dpcm_enable = "false";  \
		            cil_settletime = "0";  \
		            active_w = "3840";  \
		            active_h = "2160";  \
		            dynamic_pixel_bit_depth = "10";  \
		            csi_pixel_bit_depth = "10";  \
		            mode_type = "bayer";  \
		            pixel_phase = "rggb";  \
		            readout_orientation = "0";  \
		            line_length = "9000";  \
		            inherent_gain = "1";  \
		            pix_clk_hz = "475200000";  \
		            gain_factor = "10";  \
		            min_gain_val = "0";  \
		            max_gain_val = "480";  \
		            step_gain_val = "1";  \
		            default_gain = "0";  \
		            min_hdr_ratio = "1";  \
		            max_hdr_ratio = "64";  \
		            framerate_factor = "1000000";  \
		            min_framerate = "1500000";  \
		            max_framerate = "36000000";  \
		            step_framerate = "1";  \
		            default_framerate= "36000000";  \
		            exposure_factor = "1000000";  \
		            min_exp_time = "14";  \
		            max_exp_time = "660000";  \
		            step_exp_time = "1";  \
		            default_exp_time = "27879";  \
		            embedded_metadata_height = "0";


#define SENSOR_MODE7				mclk_khz = "37125";  \
		            phy_mode = "DPHY";  \
		            discontinuous_clk = "no";  \
		            dpcm_enable = "false";  \
		            cil_settletime = "0";  \
		            active_w = "4512";  \
		            active_h = "4512";  \
		            dynamic_pixel_bit_depth = "10";  \
		            csi_pixel_bit_depth = "10";  \
		            mode_type = "bayer";  \
		            pixel_phase = "rggb";  \
		            readout_orientation = "0";  \
		            line_length = "9000";  \
		            inherent_gain = "1";  \
		            pix_clk_hz = "475200000";  \
		            gain_factor = "10";  \
		            min_gain_val = "0";  \
		            max_gain_val = "480";  \
		            step_gain_val = "1";  \
		            default_gain = "0";  \
		            min_hdr_ratio = "1";  \
		            max_hdr_ratio = "64";  \
		            framerate_factor = "1000000";  \
		            min_framerate = "1500000";  \
		            max_framerate = "18000000";  \
		            step_framerate = "1";  \
		            default_framerate= "18000000";  \
		            exposure_factor = "1000000";  \
		            min_exp_time = "14";  \
		            max_exp_time = "660000";  \
		            step_exp_time = "1";  \
		            default_exp_time = "27879";  \
		            embedded_metadata_height = "0";


#define SENSOR_MODE8				mclk_khz = "37125";  \
		            phy_mode = "DPHY";  \
		            discontinuous_clk = "no";  \
		            dpcm_enable = "false";  \
		            cil_settletime = "0";  \
		            active_w = "4064";  \
		            active_h = "3008";  \
		            dynamic_pixel_bit_depth = "10";  \
		            csi_pixel_bit_depth = "10";  \
		            mode_type = "bayer";  \
		            pixel_phase = "rggb";  \
		            readout_orientation = "0";  \
		            line_length = "9000";  \
		            inherent_gain = "1";  \
		            pix_clk_hz = "475200000";  \
		            gain_factor = "10";  \
		            min_gain_val = "0";  \
		            max_gain_val = "480";  \
		            step_gain_val = "1";  \
		            default_gain = "0";  \
		            min_hdr_ratio = "1";  \
		            max_hdr_ratio = "64";  \
		            framerate_factor = "1000000";  \
		            min_framerate = "1500000";  \
		            max_framerate = "27000000";  \
		            step_framerate = "1";  \
		            default_framerate= "27000000";  \
		            exposure_factor = "1000000";  \
		            min_exp_time = "14";  \
		            max_exp_time = "660000";  \
		            step_exp_time = "1";  \
		            default_exp_time = "27879";  \
		            embedded_metadata_height = "0";


								
/{
	nvidia,dtsfilename = "tegra194-cti-fsm-imx530-modes-header.dtsi";
	nvidia,dtbbuildtime = __DATE__, __TIME__;
};
