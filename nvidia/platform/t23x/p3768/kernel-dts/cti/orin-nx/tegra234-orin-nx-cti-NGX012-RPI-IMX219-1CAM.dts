
#include "tegra234-orin-nx-cti-NGX012.dts"
#include "../cti_camera/tegra234-orin-nx-cti-NGX012-RPI-IMX219-base.dtsi"

/{
    nvidia,dtsfilename = "tegra234-orin-nx-cti-NGX012-RPI-IMX219-1CAM.dts";
};

#if LINUX_VERSION >= 414
#include <tegra194-linux-4.14.dtsi>
#endif


