/dts-v1/;
#include "tegra234-orin-nano-cti-NGX007.dts"
#include "../cti_camera/tegra234-orin-nx-cti-NGX007-FSM-IMX304-2CAM.dtsi"
/ {
		nvidia,dtsfilename = "tegra234-orin-nano-cti-NGX007-FSM-IMX304-2CAM.dts";
		nvidia,dtbbuldtime = __DATE__, __TIME__;

};
