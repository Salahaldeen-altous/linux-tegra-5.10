/*
 * Copyright (c) 2022, Connect Tech Inc.  All rights reserved.
 *
 * This program is free software; you can redistribute it and/or modify it
 * under the terms and conditions of the GNU General Public License,
 * version 2, as published by the Free Software Foundation.
 *
 * This program is distributed in the hope it will be useful, but WITHOUT
 * ANY WARRANTY; without even the implied warranty of MERCHANTABILITY or
 * FITNESS FOR A PARTICULAR PURPOSE.  See the GNU General Public License for
 * more details.
 *
 * You should have received a copy of the GNU General Public License
 * along with this program.  If not, see <http://www.gnu.org/licenses/>.
 */


#include <dt-bindings/gpio/tegra234-gpio.h>
#include <dt-bindings/pwm/pwm.h>

#include <t234-common-cvm/tegra234-thermal.dtsi>
#include <t234-common-cvm/tegra234-thermal-cooling.dtsi>
#include <t234-common-cvm/tegra234-thermal-userspace-alert.dtsi>

/ {
    //FAN PWM
    pwm@32a0000 {
        status = "okay";
    };

    pwm-fan {
        compatible = "pwm-fan";
        status = "okay";
        pwms = <&tegra_pwm3 0 45334>;
        cooling-levels = <128 135 178 200 255 255 255 255 255 255>;
    };


    tachometer@39c0000 {
        status = "okay";
        upper-threshold = <0xfffff>;
        lower-threshold = <0x0>;
    };


};
