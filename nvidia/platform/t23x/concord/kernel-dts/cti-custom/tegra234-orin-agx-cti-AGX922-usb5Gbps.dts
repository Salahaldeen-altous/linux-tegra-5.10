/*
 * Copyright (c) 2022, Connect Tech Inc.  All rights reserved.
 *
 * This program is free software; you can redistribute it and/or modify it
 * under the terms and conditions of the GNU General Public License,
 * version 2, as published by the Free Software Foundation.
 *
 * This program is distributed in the hope it will be useful, but WITHOUT
 * ANY WARRANTY; without even the implied warranty of MERCHANTABILITY or
 * FITNESS FOR A PARTICULAR PURPOSE.  See the GNU General Public License for
 * more details.
 *
 * You should have received a copy of the GNU General Public License
 * along with this program.  If not, see <http://www.gnu.org/licenses/>.
 */

#include "tegra234-orin-agx-cti-AGX922.dts"

/{
    nvidia,dtsfilename = "tegra234-orin-agx-cti-AGX922-usb5Gbps.dts";


	xusb_padctl@3520000{
		status = "okay";
		ports{
			usb3-2 {
				nvidia,usb2-companion = <3>;
				status = "okay";
				maximum-speed = "super-speed";  // limits speeds to 5Gbps 
            };
		};
	};

};

