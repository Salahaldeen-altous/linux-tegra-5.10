/*
 * Copyright (c) 2022, Connect Tech Inc.  All rights reserved.
 *
 * This program is free software; you can redistribute it and/or modify it
 * under the terms and conditions of the GNU General Public License,
 * version 2, as published by the Free Software Foundation.
 *
 * This program is distributed in the hope it will be useful, but WITHOUT
 * ANY WARRANTY; without even the implied warranty of MERCHANTABILITY or
 * FITNESS FOR A PARTICULAR PURPOSE.  See the GNU General Public License for
 * more details.
 *
 * You should have received a copy of the GNU General Public License
 * along with this program.  If not, see <http://www.gnu.org/licenses/>.
 */

#include "tegra234-orin-agx-cti-AGX201.dts"
#include "cti_camera/tegra234-orin-agx-cti-camera-LI-HAWK.dtsi"

/{
    nvidia,dtsfilename = "tegra234-orin-agx-cti-AGX201-JCB002-LI-HAWK.dts";

};

