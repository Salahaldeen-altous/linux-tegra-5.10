mode0 {
	mclk_khz = "37125";
	num_lanes = CAM_LANES_STRING;
	tegra_sinterface = TEGRA_SINTERFACE;
	vc_id = LOCAL_VC_ID;
	phy_mode = "DPHY";
	discontinuous_clk = "no";
	dpcm_enable = "false";
	cil_settletime = "0"; 
	dynamic_pixel_bit_depth = "10";
	csi_pixel_bit_depth = "10";
	mode_type = "bayer";
	pixel_phase = "rggb";
	active_w = "3840";
	active_h = "2160";
	readout_orientation = "0";
	line_length = "857";
	inherent_gain = "1";
	mclk_multiplier = "6.67";
	serdes_pix_clk_hz = SERDES_PIX_CLK_4K;
	//serdes_pix_clk_hz = "160000000"; 
	//pix_clk_hz = "160000000"; 
	pix_clk_hz = PIX_CLK;
	gain_factor = "10";
	min_gain_val = "0";
	max_gain_val = "300";
	step_gain_val = "3";
	default_gain = "0";
	min_hdr_ratio = "1";
	max_hdr_ratio = "1";
	framerate_factor = "1000000";
	min_framerate = "2500000";
	max_framerate = "39000000";
	step_framerate = "1";
	default_framerate = "39000000";
	exposure_factor = "1000000";
	min_exp_time = "450";
	max_exp_time = "400000";
	step_exp_time = "1";
	default_exp_time = "16667";
	embedded_metadata_height = "0";
};

#if 0
/*
mode1 {
	mclk_khz = "37125"; 
	num_lanes = "2"; 
	tegra_sinterface = TEGRA_SINTERFACE; 
	phy_mode = "DPHY";
	discontinuous_clk = "no";
	dpcm_enable = "false";
	cil_settletime = "0";
	dynamic_pixel_bit_depth = "12";
	csi_pixel_bit_depth = "12";
	mode_type = "bayer";
	pixel_phase = "rggb";

	active_w = "3840";
	ctive_h = "2160";
	readout_orientation = "0";
	line_length = "1018";
	inherent_gain = "1";
	mclk_multiplier = "6.67";
	serdes_pix_clk_hz = "160000000";
	pix_clk_hz = "160000000";
	gain_factor = "10";
	min_gain_val = "0";
	max_gain_val = "300";
	step_gain_val = "3";
	default_gain = "0";
	min_hdr_ratio = "1";
	max_hdr_ratio = "1";
	framerate_factor = "1000000";
	min_framerate = "2500000";
	max_framerate = "33000000";
	step_framerate = "1";
	default_framerate = "33000000";
	exposure_factor = "1000000";
	min_exp_time = "450";
	max_exp_time = "400000";
	step_exp_time = "1";
	default_exp_time = "16667";
	embedded_metadata_height = "0";
};

mode2 {
	mclk_khz = "37125";
	num_lanes = "2";
	tegra_sinterface = TEGRA_SINTERFACE;
	phy_mode = "DPHY";
	discontinuous_clk = "no";
	dpcm_enable = "false";
	cil_settletime = "0";
	dynamic_pixel_bit_depth = "12";
	csi_pixel_bit_depth = "12";
	mode_type = "bayer";
	pixel_phase = "rggb";
	
	active_w = "1920";
	active_h = "1080";
	readout_orientation = "0";
	line_length = "535";
	inherent_gain = "1";
	mclk_multiplier = "6.67"; //"25.6";
	//serdes_pix_clk_hz = "160000000";
	serdes_pix_clk_hz = SERDES_PIX_CLK;
	pix_clk_hz = "160000000"; 
	gain_factor = "10";
	min_gain_val = "0";
	max_gain_val = "300";
	step_gain_val = "3";
	default_gain = "0";
	min_hdr_ratio = "1";
	max_hdr_ratio = "1";
	framerate_factor = "1000000";
	min_framerate = "2500000";
	max_framerate = "62000000";
	step_framerate = "1";
	default_framerate = "62000000";
	exposure_factor = "1000000";
	min_exp_time = "450";
	max_exp_time = "400000";
	step_exp_time = "1";
	default_exp_time = "16667";
	embedded_metadata_height = "0";
};
*/
#endif

mode1 {
	mclk_khz = "37125";
	num_lanes = CAM_LANES_STRING;
	tegra_sinterface = TEGRA_SINTERFACE;
	vc_id = LOCAL_VC_ID;
	phy_mode = "DPHY";
	discontinuous_clk = "no";
	dpcm_enable = "false";
	cil_settletime = "0";
	dynamic_pixel_bit_depth = "10";
	csi_pixel_bit_depth = "10";
	mode_type = "bayer";
	pixel_phase = "rggb";
	
	active_w = "1920";
	active_h = "1080";
	readout_orientation = "0";
	line_length = "535";
	inherent_gain = "1";
	mclk_multiplier = "6.67";
        //serdes_pix_clk_hz = "160000000";
	serdes_pix_clk_hz = SERDES_PIX_CLK;
	pix_clk_hz = PIX_CLK;
	//pix_clk_hz = "160000000";
	gain_factor = "10";
	min_gain_val = "0";
	max_gain_val = "300";
	step_gain_val = "3";
	default_gain = "0";
	min_hdr_ratio = "1";
	max_hdr_ratio = "1";
	framerate_factor = "1000000";
	min_framerate = "2500000";
	max_framerate = "62000000";
	step_framerate = "1";
	default_framerate = "62000000";
	exposure_factor = "1000000";
	min_exp_time = "450";
	max_exp_time = "400000";
	step_exp_time = "1";
	default_exp_time = "16667";
	embedded_metadata_height = "0";
};


