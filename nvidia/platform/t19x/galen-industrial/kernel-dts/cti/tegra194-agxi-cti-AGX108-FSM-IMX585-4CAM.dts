/*
 * Top level DTS file for AGX001.
 */

#include "tegra194-agxi-cti-AGX108.dts"
#include "../../galen/kernel-dts/cti/cti_camera/tegra194-agx-cti-FSM-IMX585-4CAM.dtsi"


/{
    nvidia,dtsfilename = "tegra194-agxi-cti-AGX108-FSM-IMX585-4CAM.dts";
    nvidia,dtbbuildtime = __DATE__, __TIME__;
};
