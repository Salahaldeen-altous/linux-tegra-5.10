/*
 * Top level DTS file for AGX001.
 */

#include "tegra194-agx-cti-AGX108.dts"
#include "cti_camera/tegra194-agx-cti-FSM-IMX412-4CAM.dtsi"

/{
    nvidia,dtsfilename = "tegra194-agx-cti-AGX108-FSM-IMX412-4CAM.dts";
    nvidia,dtbbuildtime = __DATE__, __TIME__;
};
