#define SENSOR_MODE0			mclk_khz = "37125"; \
								phy_mode = "DPHY"; \
								discontinuous_clk = "no"; \
								dpcm_enable = "false"; \
								cil_settletime = "0"; \
								active_w = "1920"; \
								active_h = "1080"; \
								dynamic_pixel_bit_depth = "10"; \
								csi_pixel_bit_depth = "10"; \
								mode_type = "bayer"; \
								pixel_phase = "rggb"; \
								readout_orientation = "0"; \
								line_length = "1650"; \
								inherent_gain = "1"; \
								pix_clk_hz = "356400000"; \
								gain_factor = "10"; \
								min_gain_val = "0"; \
								max_gain_val = "720"; \
								step_gain_val = "3"; \
								default_gain = "0"; \
								min_hdr_ratio = "1"; \
								max_hdr_ratio = "64"; \
								framerate_factor = "1000000"; \
								min_framerate = "1500000"; \
								max_framerate = "120000000"; \
								step_framerate = "1"; \
								default_framerate= "120000000"; \
								exposure_factor = "1000000"; \
								min_exp_time = "7"; \
								max_exp_time = "660000"; \
								step_exp_time = "1"; \
								default_exp_time = "10000"; \
								embedded_metadata_height = "1";

#define SENSOR_MODE1			mclk_khz = "37125"; \
								phy_mode = "DPHY"; \
								discontinuous_clk = "no"; \
								dpcm_enable = "false"; \
								cil_settletime = "0"; \
								active_w = "1280"; \
								active_h = "720"; \
								dynamic_pixel_bit_depth = "10"; \
								csi_pixel_bit_depth = "10"; \
								mode_type = "bayer"; \
								pixel_phase = "rggb"; \
								readout_orientation = "0"; \
								line_length = "1650"; \
								inherent_gain = "1"; \
								pix_clk_hz = "356400000"; \
								gain_factor = "10"; \
								min_gain_val = "0"; \
								max_gain_val = "720"; \
								step_gain_val = "3"; \
								default_gain = "0"; \
								min_hdr_ratio = "1"; \
								max_hdr_ratio = "64"; \
								framerate_factor = "1000000"; \
								min_framerate = "1500000"; \
								max_framerate = "120000000"; \
								step_framerate = "1"; \
								default_framerate= "120000000"; \
								exposure_factor = "1000000"; \
								min_exp_time = "11"; \
								max_exp_time = "660000"; \
								step_exp_time = "1"; \
								default_exp_time = "10000"; \
								embedded_metadata_height = "1";


#define SENSOR_MODE2			mclk_khz = "37125"; \
								phy_mode = "DPHY"; \
								discontinuous_clk = "no"; \
								dpcm_enable = "false"; \
								cil_settletime = "0"; \
								active_w = "640"; \
								active_h = "480"; \
								dynamic_pixel_bit_depth = "10"; \
								csi_pixel_bit_depth = "10"; \
								mode_type = "bayer"; \
								pixel_phase = "rggb"; \
								readout_orientation = "0"; \
								line_length = "1650"; \
								inherent_gain = "1"; \
								pix_clk_hz = "356400000"; \
								gain_factor = "10"; \
								min_gain_val = "0"; \
								max_gain_val = "720"; \
								step_gain_val = "3"; \
								default_gain = "0"; \
								min_hdr_ratio = "1"; \
								max_hdr_ratio = "64"; \
								framerate_factor = "1000000"; \
								min_framerate = "1500000"; \
								max_framerate = "267000000"; \
								step_framerate = "1"; \
								default_framerate= "240000000"; \
								exposure_factor = "1000000"; \
								min_exp_time = "7"; \
								max_exp_time = "660000"; \
								step_exp_time = "1"; \
								default_exp_time = "10000"; \
								embedded_metadata_height = "1";

#define SENSOR_MODE3			mclk_khz = "37125"; \
								phy_mode = "DPHY"; \
								discontinuous_clk = "no"; \
								dpcm_enable = "false"; \
								cil_settletime = "0"; \
								active_w = "1920"; \
								active_h = "1080"; \
								dynamic_pixel_bit_depth = "12"; \
								csi_pixel_bit_depth = "12"; \
								mode_type = "bayer"; \
								pixel_phase = "rggb"; \
								readout_orientation = "0"; \
								line_length = "6600"; \
								inherent_gain = "1"; \
								pix_clk_hz = "356400000"; \
								gain_factor = "10"; \
								min_gain_val = "0"; \
								max_gain_val = "720"; \
								step_gain_val = "3"; \
								default_gain = "0"; \
								min_hdr_ratio = "1"; \
								max_hdr_ratio = "64"; \
								framerate_factor = "1000000"; \
								min_framerate = "1500000"; \
								max_framerate = "60000000"; \
								step_framerate = "1"; \
								default_framerate= "60000000"; \
								exposure_factor = "1000000"; \
								min_exp_time = "15"; \
								max_exp_time = "660000"; \
								step_exp_time = "1"; \
								default_exp_time = "10000"; \
								embedded_metadata_height = "1";

#define SENSOR_MODE4			mclk_khz = "37125"; \
								phy_mode = "DPHY"; \
								discontinuous_clk = "no"; \
								dpcm_enable = "false"; \
								cil_settletime = "0"; \
								active_w = "1280"; \
								active_h = "720"; \
								dynamic_pixel_bit_depth = "12"; \
								csi_pixel_bit_depth = "12"; \
								mode_type = "bayer"; \
								pixel_phase = "rggb"; \
								readout_orientation = "0"; \
								line_length = "6600"; \
								inherent_gain = "1"; \
								pix_clk_hz = "356400000"; \
								gain_factor = "10"; \
								min_gain_val = "0"; \
								max_gain_val = "720"; \
								step_gain_val = "3"; \
								default_gain = "0"; \
								min_hdr_ratio = "1"; \
								max_hdr_ratio = "64"; \
								framerate_factor = "1000000"; \
								min_framerate = "1500000"; \
								max_framerate = "60000000"; \
								step_framerate = "1"; \
								default_framerate= "60000000"; \
								exposure_factor = "1000000"; \
								min_exp_time = "22"; \
								max_exp_time = "660000"; \
								step_exp_time = "1"; \
								default_exp_time = "10000"; \
								embedded_metadata_height = "1";


#define SENSOR_MODE5			mclk_khz = "37125"; \
								phy_mode = "DPHY"; \
								discontinuous_clk = "no"; \
								dpcm_enable = "false"; \
								cil_settletime = "0"; \
								active_w = "640"; \
								active_h = "480"; \
								dynamic_pixel_bit_depth = "12"; \
								csi_pixel_bit_depth = "12"; \
								mode_type = "bayer"; \
								pixel_phase = "rggb"; \
								readout_orientation = "0"; \
								line_length = "6600"; \
								inherent_gain = "1"; \
								pix_clk_hz = "356400000"; \
								gain_factor = "10"; \
								min_gain_val = "0"; \
								max_gain_val = "720"; \
								step_gain_val = "3"; \
								default_gain = "0"; \
								min_hdr_ratio = "1"; \
								max_hdr_ratio = "64"; \
								framerate_factor = "1000000"; \
								min_framerate = "1500000"; \
								max_framerate = "133000000"; \
								step_framerate = "1"; \
								default_framerate= "120000000"; \
								exposure_factor = "1000000"; \
								min_exp_time = "15"; \
								max_exp_time = "660000"; \
								step_exp_time = "1"; \
								default_exp_time = "10000"; \
								embedded_metadata_height = "1";
							
#define SENSOR_MODE6			mclk_khz = "37125"; \
								phy_mode = "DPHY"; \
								discontinuous_clk = "no"; \
								dpcm_enable = "false"; \
								cil_settletime = "0"; \
								active_w = "640"; \
								active_h = "480"; \
								dynamic_pixel_bit_depth = "12"; \
								csi_pixel_bit_depth = "12"; \
								mode_type = "bayer"; \
								pixel_phase = "rggb"; \
								readout_orientation = "0"; \
								line_length = "6600"; \
								inherent_gain = "1"; \
								pix_clk_hz = "356400000"; \
								gain_factor = "10"; \
								min_gain_val = "0"; \
								max_gain_val = "720"; \
								step_gain_val = "3"; \
								default_gain = "0"; \
								min_hdr_ratio = "1"; \
								max_hdr_ratio = "64"; \
								framerate_factor = "1000000"; \
								min_framerate = "1500000"; \
								max_framerate = "133000000"; \
								step_framerate = "1"; \
								default_framerate= "120000000"; \
								exposure_factor = "1000000"; \
								min_exp_time = "15"; \
								max_exp_time = "660000"; \
								step_exp_time = "1"; \
								default_exp_time = "10000"; \
								embedded_metadata_height = "1";

								
#define CAM_DATA						physical_w = "12.00"; \
								physical_h = "9.30"; \
								post_crop_frame_drop = "0"; \
								use_decibel_gain = "true"; \
								delayed_gain = "false"; \
								use_sensor_mode_id = "false";
								
/{
	nvidia,dtsfilename = "tegra194-camera-imx290.dtsi";
	nvidia,dtbbuildtime = __DATE__, __TIME__;
};
