#define  VI_ADDR   vi@15c10000
#define  NVCSI_ADDR   nvcsi@15a00000
#define  NUM_MIPI_CHAN   4
#define  COMPATIBLE_STRING   "framos,imx415"


#define  I2C_ADDR   i2c@3180000
#define  I2C_EXPANDER_ADDR   tca9548@70

#define  BUS_WIDTH0   4
#define  BUS_WIDTH1   4
#define  BUS_WIDTH2   4
#define  BUS_WIDTH3   4

#define  NUM_OF_LANES0   "4"
#define  NUM_OF_LANES1   "4"
#define  NUM_OF_LANES2   "4"
#define  NUM_OF_LANES3   "4"

#define CSI_PORT_INDEX0  0
#define CSI_PORT_INDEX1  2
#define CSI_PORT_INDEX2  4
#define CSI_PORT_INDEX3  6

#define VI_PORT_INDEX0  0
#define VI_PORT_INDEX1  2
#define VI_PORT_INDEX2  4
#define VI_PORT_INDEX3  5

#define  I2C0   i2c@0
#define  I2C1   i2c@2
#define  I2C2   i2c@4
#define  I2C3   i2c@6

#define  I2C_NODE0_REG   0x1a
#define  I2C_NODE1_REG   0x1a
#define  SENSOR_MODEL   "imx415"

#define  I2C0_NODE0    imx415_a@1a
#define  I2C1_NODE0    imx415_b@1a
#define  I2C2_NODE0    imx415_c@1a
#define  I2C3_NODE0    imx415_d@1a

#define  I2C0_NODE0_SINTERFACE    "serial_a"
#define  I2C1_NODE0_SINTERFACE    "serial_c"
#define  I2C2_NODE0_SINTERFACE    "serial_e"
#define  I2C3_NODE0_SINTERFACE    "serial_g"

#define  I2C0_NODE0_PORT_INDEX    0
#define  I2C1_NODE0_PORT_INDEX    2
#define  I2C2_NODE0_PORT_INDEX    4
#define  I2C3_NODE0_PORT_INDEX    6

#define TEGRA_CAM_PLAT_DATA 		num_csi_lanes = <16>; \
								max_lane_speed = <1500000>; \
								min_bits_per_pixel = <10>; \
								vi_peak_byte_per_pixel = <2>; \
								vi_bw_margin_pct = <25>; \
								max_pixel_rate = <240000>; \
								isp_peak_byte_per_pixel = <5>; \
								isp_bw_margin_pct = <25>; \
								tpg_max_iso = <3916800>;

#define  MODULE0_BADGENAME    "imx415_front_fsm_imx415"
#define  MODULE1_BADGENAME    "imx415_rear_fsm_imx415"
#define  MODULE2_BADGENAME    "imx415_centerright_fsm_imx415"
#define  MODULE3_BADGENAME    "imx415_centerleft_fsm_imx415"

#define MODULE0_DEVNAME  "imx415 30-001a"
#define MODULE1_DEVNAME  "imx415 32-001a"
#define MODULE2_DEVNAME  "imx415 34-001a"
#define MODULE3_DEVNAME  "imx415 36-001a"

#define PROC_DEVICE_TREE0  "/proc/device-tree/i2c@3180000/tca9548@70/i2c@0/imx415_a@1a"
#define PROC_DEVICE_TREE1  "/proc/device-tree/i2c@3180000/tca9548@70/i2c@2/imx415_b@1a"
#define PROC_DEVICE_TREE2  "/proc/device-tree/i2c@3180000/tca9548@70/i2c@4/imx415_c@1a"
#define PROC_DEVICE_TREE3  "/proc/device-tree/i2c@3180000/tca9548@70/i2c@6/imx415_d@1a"


/{
nvidia,dtsfilename = "tegra194-cti-camera-fsm-imx415-4cam-header.dtsi";
nvidia,dtbbuildtime = __DATE__, __TIME__;
};
