/dts-v1/;
#include "tegra194-agx-cti-AGX103.dts" 
#include "cti_camera/tegra194-agx-cti-camera-avt-csi2-6cam.dtsi" 
/{
    nvidia,dtsfilename = "tegra194-agx-cti-AGX103-JCB005-AVT-CSI2-6CAM.dts";
    nvidia,dtbbuildtime = __DATE__, __TIME__;
};
