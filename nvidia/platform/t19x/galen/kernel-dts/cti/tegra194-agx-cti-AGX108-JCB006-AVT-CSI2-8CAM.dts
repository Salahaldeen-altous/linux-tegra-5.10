/dts-v1/;
#include "tegra194-agx-cti-AGX108.dts" 
#include "cti_camera/tegra194-agx-cti-camera-jcb006-avt-csi2-8cam.dtsi" 
/{
    nvidia,dtsfilename = "tegra194-agx-cti-AGX108-JCB006-AVT-CSI2-8CAM.dts";
    nvidia,dtbbuildtime = __DATE__, __TIME__;
};
