#define  VI_ADDR   vi@15c10000
#define  NVCSI_ADDR   nvcsi@15a00000
#define  NUM_MIPI_CHAN   3
#define  COMPATIBLE_STRING   "framos,imx290"


#define  I2C_ADDR0   i2c@3180000

#define  I2C_EXPANDER_ADDR0   tca9548@70

#define  BUS_WIDTH0   4
#define  BUS_WIDTH1   4
#define  BUS_WIDTH2   4

#define  NUM_OF_LANES0   "4"
#define  NUM_OF_LANES1   "4"
#define  NUM_OF_LANES2   "4"

#define CSI_PORT_INDEX0  0
#define CSI_PORT_INDEX1  2
#define CSI_PORT_INDEX2  4

#define VI_PORT_INDEX0  0
#define VI_PORT_INDEX1  2
#define VI_PORT_INDEX2  4

#define  I2C0   i2c@0
#define  I2C1   i2c@1
#define  I2C2   i2c@3

#define  I2C_NODE0_REG   0x1a
#define  I2C_NODE1_REG   0x1a
#define  SENSOR_MODEL   "imx290"


#define  I2C0_NODE0    imx290_a@1a
#define  I2C1_NODE0    imx290_c@1a
#define  I2C2_NODE0    imx290_e@1a

#define  I2C0_NODE0_SINTERFACE    "serial_a"
#define  I2C1_NODE0_SINTERFACE    "serial_c"
#define  I2C2_NODE0_SINTERFACE    "serial_e"

/* pix_clk_hz moved to header since its calculated from Bus width value*/
#define  PIX_CLK_HZ0    "356400000"
#define  PIX_CLK_HZ1    "356400000"
#define  PIX_CLK_HZ2    "356400000"

#define  I2C0_NODE0_PORT_INDEX    0
#define  I2C1_NODE0_PORT_INDEX    2
#define  I2C2_NODE0_PORT_INDEX    4

#define MODULE0_BADGE    "imx290_front_fsm_imx290"
#define MODULE1_BADGE    "imx290_rear_fsm_imx290"
#define MODULE2_BADGE    "imx290_centerright_fsm_imx290"

#define MODULE0_DEVNAME  "imx290 30-001a"
#define MODULE1_DEVNAME  "imx290 31-001a"
#define MODULE2_DEVNAME  "imx290 33-001a"

#define PROC_DEVICE_TREE0  "/proc/device-tree/i2c@3180000/tca9548@70/i2c@0/imx290_a@1a"
#define PROC_DEVICE_TREE1  "/proc/device-tree/i2c@3180000/tca9548@70/i2c@1/imx290_c@1a"
#define PROC_DEVICE_TREE2  "/proc/device-tree/i2c@3180000/tca9548@70/i2c@3/imx290_e@1a"


/{
nvidia,dtsfilename = "tegra194-cti-camera-imx290-3cam-1mux-header.dtsi";
nvidia,dtbbuildtime = __DATE__, __TIME__;
};
