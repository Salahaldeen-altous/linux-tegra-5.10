#define I2C_ADDR					i2c@3180000
#define VI_ADDR      				vi@15c10000
#define NVCSI_ADDR					nvcsi@15a00000
#define NUM_MIPI_CHAN   			1
#define BUS_WIDTH 					4
#define COMPATIBLE_STRING			"alliedvision,avt_csi2"


#define I2C0_NODE					avt_csi2_a@3c

#define I2C_NODE_REG				0x3c

#define SENSOR_MODEL				"avt_csi2"

#define VI_CSI_PORT_INDEX0			0

#define  NUM_OF_LANES   "4"

#define MODULE0_BADGE    "avt_csi2_front_avt_csi2"

#define MODULE0_DEVNAME				"avt_csi2 0 2-003c"


#define I2C0_NODE_SINTERFACE 		"serial_a"

#define PROC_DEVICE_TREE_MODULE0	"/proc/device-tree/i2c@3180000/avt_csi2_a@3c"

/{
    nvidia,dtsfilename = "tegra194-agx-cti-camera-1cam-base-header.dtsi";
    nvidia,dtbbuildtime = __DATE__, __TIME__;
};
